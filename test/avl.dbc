VERSION ""

NS_ :

BS_:

BU_: EIM AVL

BO_ 1 cwc_temperature: 8 AVL
 SG_ cwc_pidact_t : 0|32@1+ (0.001,0) [-250|300] "C"  EIM
 SG_ cwc_wtrt_dvl : 32|32@1+ (0.001,0) [-250|300] "C" EIM
